## config/west.yml
```yaml
manifest:
  remotes:
    - name: zmkfirmware
      url-base: https://github.com/zmkfirmware
    - name: urob
      url-base: https://github.com/urob
    - name: m165437
      url-base: https://github.com/M165437
    - name: robotfu
      url-base: https://github.com/robotfu
  projects:
    - name: eyelash_corne
      url: https://github.com/a741725193/zmk-new_corne
      revision: main
    - name: zmk
      remote: urob
      revision: main
      import: app/west.yml
    - name: zmk-auto-layer
      remote: urob
      revision: v0.1
    - name: zmk-leader-key
      remote: urob
      revision: v0.2
    - name: nice-view-gem
      remote: m165437
      revision: main
    - name: zmk-config
      remote: robotfu
      revision: main
  self:
    path: config
```
